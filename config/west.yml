## config/west.yml
```yaml
manifest:
  remotes:
    - name: zmkfirmware
      url-base: https://github.com/zmkfirmware
    - name: kumamuk-git
      url-base: https://github.com/kumamuk-git
    - name: akiakirj1
      url-base: https://github.com/akiakirj1
    - name: caksoylar  # <-- new entry
      url-base: https://github.com/caksoylar
   

  projects:
    - name: zmk
      remote: zmkfirmware
      revision: v0.3-branch
      import: app/west.yml
#    - name: zmk-pmw3610-driver
#      remote: kumamuk-git
#      revision: main
    - name: zmk-pmw3610-driver
      remote: akiakirj1
      revision: main
    - name: zmk-rgbled-widget  # <-- new entry
      remote: caksoylar
      revision: main

  self:
    path: config
```
